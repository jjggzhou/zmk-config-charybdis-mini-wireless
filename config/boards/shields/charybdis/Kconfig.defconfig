## config/boards/shields/charybdis/Kconfig.defconfig
```kconfig
if SHIELD_CHARYBDIS_LEFT

config ZMK_KEYBOARD_NAME
	default "SpaceMouse Pro"

config ZMK_SPLIT_BLE_ROLE_CENTRAL
	default y

	default 0xC63A

endif

if SHIELD_CHARYBDIS_LEFT || SHIELD_CHARYBDIS_RIGHT

config ZMK_SPLIT
	default y

config USB_DEVICE_VID
	default 0x256F

config USB_DEVICE_PID
	default 0xc631

config BT_DIS_PNP_VID
	default 0x256F

config BT_DIS_PNP_PID
	
endif
```

## config/west.yml
```yaml
manifest:
  remotes:
    - name: zmk
      url-base: https://github.com/jjggzhou/
    - name: inorichi
      url-base: https://github.com/inorichi
  projects:
    - name: zmk
      remote: zmk
      revision: feat/pointers-move-scroll
      import: app/west.yml
    - name: zmk-pmw3610-driver
      remote: inorichi
      revision: main
  self:
    path: config
```
